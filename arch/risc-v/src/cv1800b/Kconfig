## arch/risc-v/src/cv1800b/Kconfig
```kconfig
#
# For a description of the syntax of this configuration file,
# see the file kconfig-language.txt in the NuttX tools repository.
#

comment "CV1800B Configuration Options"

config CV1800B_ENABLE_DPFPU
	bool "CV1800B DP_FPU Support"
	default n
	select ARCH_HAVE_FPU
	select ARCH_HAVE_DPFPU
	---help---
		Enable the RISC-V Double-Precision Floating Point Unit (DP-FPU).

menu "CV1800B Peripheral Support"

# These "hidden" settings determine whether a peripheral option is available
# for the selected MCU

config CV1800B_HAVE_UART0
	bool
	default y
	select UART0_SERIALDRIVER
	select ARCH_HAVE_SERIAL_TERMIOS

# These are the peripheral selections proper

config CV1800B_UART0
	bool "UART0"
	default y
	select ARCH_HAVE_UART0
	select ARCH_HAVE_SERIAL_TERMIOS
	select CV1800B_UART

endmenu
```
